/*
 * Device tree for the vcml-pydrofoil virtual platform.
 */

#ifndef NRCPU
#error NRCPU undefined
#endif

#if NRCPU != 1 && NRCPU != 2 && NRCPU != 4 && NRCPU != 8
#error "NRCPU must be 1, 2, 4 or 8"
#endif

/*
 * One hart: cpu@N with its local interrupt controller hartN. Every hart is
 * identical, only the index differs.
 */
#define HART(n)                                                         \
        cpu@n {                                                         \
            reg = <n>;                                                  \
            clock-frequency = <1000000000>; /* 1 GHz */                 \
            compatible = "riscv";                                       \
            device_type = "cpu";                                        \
            d-cache-block-size = <0x40>;                                \
            d-cache-sets = <0x80>;                                      \
            d-cache-size = <0x8000>;                                    \
            d-tlb-sets = <0x01>;                                        \
            d-tlb-size = <0x20>;                                        \
            i-cache-block-size = <0x40>;                                \
            i-cache-sets = <0x80>;                                      \
            i-cache-size = <0x8000>;                                    \
            i-tlb-sets = <0x01>;                                        \
            i-tlb-size = <0x20>;                                        \
            mmu-type = "riscv,sv39";                                    \
            riscv,isa = "rv64imafdc_zicsr_zifencei_zba_zbb";            \
            riscv,isa-base = "rv64i";                                   \
            riscv,isa-extensions = "i", "m", "a", "f", "d", "c",        \
                                   "zicsr", "zifencei", "zba", "zbb";   \
            tlb-split;                                                  \
                                                                        \
            hart##n: interrupt-controller {                             \
                #interrupt-cells = <1>;                                 \
                compatible = "riscv,cpu-intc";                          \
                interrupt-controller;                                   \
            };                                                          \
        };

/*
 * Per hart: CLINT software (3) and timer (7) interrupt, PLIC M-mode (11) and
 * S-mode (9) external interrupt. The VP binds clint.irq_sw/irq_timer[i] and
 * plic.irqt[2i] / irqt[2i+1] to hart i, in this order.
 */
#if NRCPU == 1
#define CLINT_IRQS <&hart0 3>, <&hart0 7>
#define PLIC_IRQS  <&hart0 11>, <&hart0 9>
#elif NRCPU == 2
#define CLINT_IRQS <&hart0 3>, <&hart0 7>, <&hart1 3>, <&hart1 7>
#define PLIC_IRQS  <&hart0 11>, <&hart0 9>, <&hart1 11>, <&hart1 9>
#elif NRCPU == 4
#define CLINT_IRQS <&hart0 3>, <&hart0 7>, <&hart1 3>, <&hart1 7>, \
                   <&hart2 3>, <&hart2 7>, <&hart3 3>, <&hart3 7>
#define PLIC_IRQS  <&hart0 11>, <&hart0 9>, <&hart1 11>, <&hart1 9>, \
                   <&hart2 11>, <&hart2 9>, <&hart3 11>, <&hart3 9>
#else
#define CLINT_IRQS <&hart0 3>, <&hart0 7>, <&hart1 3>, <&hart1 7>, \
                   <&hart2 3>, <&hart2 7>, <&hart3 3>, <&hart3 7>, \
                   <&hart4 3>, <&hart4 7>, <&hart5 3>, <&hart5 7>, \
                   <&hart6 3>, <&hart6 7>, <&hart7 3>, <&hart7 7>
#define PLIC_IRQS  <&hart0 11>, <&hart0 9>, <&hart1 11>, <&hart1 9>, \
                   <&hart2 11>, <&hart2 9>, <&hart3 11>, <&hart3 9>, \
                   <&hart4 11>, <&hart4 9>, <&hart5 11>, <&hart5 9>, \
                   <&hart6 11>, <&hart6 9>, <&hart7 11>, <&hart7 9>
#endif

/dts-v1/;

/ {
    #address-cells = <2>;
    #size-cells = <2>;
    compatible = "riscv-virtio";
    model = "vcml-pydrofoil VP";

    chosen {
        bootargs = "root=/dev/vda rootwait console=ttyS0 earlycon no4lvl";
        stdout-path = "/uart@10000000";

        #address-cells = <2>;
        #size-cells = <2>;
        ranges;
    };

    cpus {
        #address-cells = <1>;
        #size-cells = <0>;

        timebase-frequency = <10000000>; // 10 MHz

        HART(0)
#if NRCPU > 1
        HART(1)
#endif
#if NRCPU > 2
        HART(2)
        HART(3)
#endif
#if NRCPU > 4
        HART(4)
        HART(5)
        HART(6)
        HART(7)
#endif
    };

    memory@80000000 {
        device_type = "memory";
        reg = <0x0 0x80000000 0x0 0x20000000>; // 512 MiB
    };

    syscon: simdev@100000 {
        compatible = "sifive,test1", "sifive,test0", "syscon";
        reg = <0x0 0x00100000 0x0 0x1000>;
    };

    reboot {
        compatible = "syscon-reboot";
        regmap = <&syscon>;
        offset = <0x0>;
        value = <0x7777>;
    };

    poweroff {
        compatible = "syscon-poweroff";
        regmap = <&syscon>;
        offset = <0x0>;
        value = <0x5555>;
    };

    clint@2000000 {
        compatible = "sifive,clint0", "riscv,clint0";
        reg = <0x0 0x02000000 0x0 0x000c0000>;
        interrupts-extended = CLINT_IRQS;
    };

    plic: interrupt-controller@c000000 {
        #address-cells = <0>;
        #interrupt-cells = <1>;
        reg = <0x0 0x0c000000 0x0 0x04000000>;
        compatible = "sifive,plic-1.0.0", "riscv,plic0";
        interrupt-controller;
        /*
         * Context 2i = hart i M-external (OpenSBI), context 2i+1 = hart i
         * S-external (Linux). The platform binds plic.irqt[2i] and
         * plic.irqt[2i+1] to hart i's MEIP and SEIP inputs in that order.
         */
        interrupts-extended = PLIC_IRQS;
        riscv,ndev = <64>;
    };

    uartclk: clk3mhz {
        compatible = "fixed-clock";
        #clock-cells = <0>;
        clock-frequency = <3686400>; /* 3.6864 MHz */
    };

    ioclk: clk100mhz {
        compatible = "fixed-clock";
        #clock-cells = <0>;
        clock-frequency = <100000000>;
    };

    /* vcml::serial::uart8250 -- byte registers at offsets 0..7, so the
     * ns16550a defaults (reg-shift = 0, reg-io-width = 1) apply. */
    uart0: uart@10000000 {
        compatible = "ns16550a";
        clocks = <&uartclk>;
        /*
         * OpenSBI reads clock-frequency straight off this node and ignores
         * the clocks phandle (fdt_parse_uart_node_common)
         */
        clock-frequency = <3686400>;
        reg = <0x0 0x10000000 0x0 0x1000>;
        interrupt-parent = <&plic>;
        interrupts = <1>;
    };

    hwrng0: hwrng@10001000 {
        compatible = "timeriomem_rng";
        reg = <0x0 0x10001000 0x0 0x1000>;
        quality = <1000>;
        period = <0>;
    };

    virtio@14000000 {
        compatible = "virtio,mmio";
        reg = <0x0 0x14000000 0x0 0x1000>;
        interrupt-parent = <&plic>;
        interrupts = <12>;
    };
};
